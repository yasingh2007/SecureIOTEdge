## apps/secure_iot_edge/Kconfig
```kconfig
mainmenu "Secure IoT Edge Application"

source "Kconfig.zephyr"

menu "Secure IoT Edge"

config SECURE_IOT_EDGE_APP_VERSION
	string "Application version string (telemetry + OTA demo)"
	default "1.0.0"

config SECURE_IOT_EDGE_BLE_PROVISION
	bool "Enable BLE Wi-Fi provisioning"
	default y
	depends on BT

config SECURE_IOT_EDGE_BLE_PROVISION_WINDOW_SEC
	int "BLE provisioning window duration (seconds)"
	default 300
	depends on SECURE_IOT_EDGE_BLE_PROVISION
	help
	  Stops BLE advertising when this timer expires. Writes are rejected after close.

config SECURE_IOT_EDGE_BLE_PROVISION_ALWAYS
	bool "Advertise for provisioning even when credentials exist"
	default n
	depends on SECURE_IOT_EDGE_BLE_PROVISION

config SECURE_IOT_EDGE_BLE_PROVISION_STOP_ON_NETWORK
	bool "Stop BLE advertising when IPv4/DHCP is ready"
	default y
	depends on SECURE_IOT_EDGE_BLE_PROVISION

config SECURE_IOT_EDGE_WIFI
	bool "Enable Wi-Fi station manager"
	default y
	depends on WIFI

config SECURE_IOT_EDGE_WIFI_SSID
	string "Lab Wi-Fi SSID (optional if using BLE/NVS)"
	default ""
	depends on SECURE_IOT_EDGE_WIFI

config SECURE_IOT_EDGE_WIFI_PSK
	string "Lab Wi-Fi PSK (optional)"
	default ""
	depends on SECURE_IOT_EDGE_WIFI

config SECURE_IOT_EDGE_WIFI_RECONNECT_MIN_SEC
	int "Minimum Wi-Fi reconnect backoff (seconds)"
	default 3
	depends on SECURE_IOT_EDGE_WIFI

config SECURE_IOT_EDGE_WIFI_RECONNECT_MAX_SEC
	int "Maximum Wi-Fi reconnect backoff (seconds)"
	default 120
	depends on SECURE_IOT_EDGE_WIFI

config SECURE_IOT_EDGE_MQTT
	bool "Enable MQTT cloud client"
	default y
	depends on MQTT_LIB

config SECURE_IOT_EDGE_MQTT_TLS
	bool "Use TLS for MQTT"
	default y
	depends on SECURE_IOT_EDGE_MQTT && MQTT_LIB_TLS

config SECURE_IOT_EDGE_MQTT_TLS_SEC_TAG
	int "TLS credential security tag"
	default 1
	depends on SECURE_IOT_EDGE_MQTT_TLS

config SECURE_IOT_EDGE_MQTT_TLS_INSECURE
	bool "Disable TLS certificate verification (lab only)"
	default n
	depends on SECURE_IOT_EDGE_MQTT_TLS
	help
	  Sets TLS peer verify to NONE. Never enable in production firmware.

config SECURE_IOT_EDGE_MQTT_HOST
	string "MQTT broker hostname or IP"
	default "mqtt.example.com"
	depends on SECURE_IOT_EDGE_MQTT

config SECURE_IOT_EDGE_MQTT_PORT
	int "MQTT broker port"
	default 8883 if SECURE_IOT_EDGE_MQTT_TLS
	default 1883
	depends on SECURE_IOT_EDGE_MQTT

config SECURE_IOT_EDGE_MQTT_CLIENT_ID
	string "MQTT client ID prefix"
	default "secure-iot-edge"
	depends on SECURE_IOT_EDGE_MQTT

config SECURE_IOT_EDGE_MQTT_TOPIC_TELEMETRY
	string "Telemetry publish topic"
	default "iot/edge/telemetry"
	depends on SECURE_IOT_EDGE_MQTT

config SECURE_IOT_EDGE_MQTT_TOPIC_CMD
	string "Command subscribe topic"
	default "iot/edge/cmd"
	depends on SECURE_IOT_EDGE_MQTT

config SECURE_IOT_EDGE_MQTT_KEEPALIVE
	int "MQTT keepalive seconds"
	default 60
	depends on SECURE_IOT_EDGE_MQTT

config SECURE_IOT_EDGE_MQTT_PUBLISH_INTERVAL
	int "Telemetry publish interval seconds"
	default 30
	depends on SECURE_IOT_EDGE_MQTT

config SECURE_IOT_EDGE_FOTA
	bool "Enable FOTA (MCUboot image confirm)"
	default y
	depends on IMG_MANAGER

config SECURE_IOT_EDGE_FOTA_SELF_TEST
	bool "Run self-tests before confirming an OTA image"
	default y
	depends on SECURE_IOT_EDGE_FOTA

config SECURE_IOT_EDGE_FOTA_SELF_TEST_REQUIRE_WIFI
	bool "Self-test requires Wi-Fi link"
	default y
	depends on SECURE_IOT_EDGE_FOTA_SELF_TEST

config SECURE_IOT_EDGE_FOTA_SELF_TEST_REQUIRE_MQTT
	bool "Self-test requires MQTT session"
	default y
	depends on SECURE_IOT_EDGE_FOTA_SELF_TEST

config SECURE_IOT_EDGE_FOTA_SELF_TEST_REQUIRE_SENSOR
	bool "Self-test requires telemetry JSON"
	default y
	depends on SECURE_IOT_EDGE_FOTA_SELF_TEST

config SECURE_IOT_EDGE_FOTA_SELF_TEST_MIN_UPTIME_MS
	int "Minimum uptime before self-test (ms)"
	default 15000
	depends on SECURE_IOT_EDGE_FOTA_SELF_TEST

config SECURE_IOT_EDGE_FOTA_CONFIRM_BYPASS
	bool "Allow MQTT fota_confirm without passing self-test"
	default n
	depends on SECURE_IOT_EDGE_FOTA

config SECURE_IOT_EDGE_MCUMGR_BLE_OTA
	bool "Project helpers for MCUmgr SMP over BLE"
	default y
	depends on SECURE_IOT_EDGE_FOTA && BT && MCUMGR_TRANSPORT_BT
	help
	  Enable prj.conf MCUMGR_TRANSPORT_BT and fota_smp_bt advertising hooks.

config SECURE_IOT_EDGE_SENSORS
	bool "Enable sensor hub"
	default y

config SECURE_IOT_EDGE_POWER_MGMT
	bool "Enable application power policy"
	default y
	depends on PM

config SECURE_IOT_EDGE_DIAG_SHELL
	bool "Enable diagnostic shell commands"
	default n
	depends on SHELL

endmenu
```
